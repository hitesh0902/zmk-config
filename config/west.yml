## config/west.yml
```yaml
manifest:
  remotes:
    - name: zmkfirmware
      url-base: https://github.com/zmkfirmware
    # Additional modules containing boards/shields/custom code can be listed here as well
    # See https://zephyrproject.readthedocs.io/en/latest/guide/west/manifest.html#projects
    - name: keeb-it
      url-base: https://github.com/keeb-it
  projects:
    - name: zmk
      remote: zmkfirmware
      revision: v0.3.0
      import: app/west.yml
    - name: zmk-keyboards
      remote: keeb-it
      revision: main
  self:
    path: config
```
